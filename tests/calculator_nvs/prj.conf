## CMakeLists.txt
```
cmake_minimum_required(VERSION 3.20.0)
find_package(Zephyr REQUIRED HINTS $ENV{ZEPHYR_BASE})

project(calculator_nvs_unit_test)

target_sources(app PRIVATE
    src/nvs_fake.c
    src/test_basic.c
    src/test_error_paths.c
    ${CMAKE_CURRENT_SOURCE_DIR}/../../app/modules/calculator_nvs/src/calculator_nvs.c
)

target_include_directories(app PRIVATE
    ${CMAKE_CURRENT_SOURCE_DIR}/../../app/modules/calculator_nvs/include
    include
)
```

## prj.conf
```kconfig
# Enable the Ztest unit testing framework
CONFIG_ZTEST=y

# Randomize suite and test order to catch ordering dependencies early
CONFIG_ZTEST_SHUFFLE=y

# Enable logging
CONFIG_LOG=y

# CONFIG_NVS stays disabled: src/nvs_fake.c replaces the NVS functions
```

## include/nvs_fake.h
```c
/*
 * NVS Fake - FFF declarations and helper API
 *
 * DECLARE_* is here, so both test files share the fakes. DEFINE_* is in
 * nvs_fake.c, exactly once.
 */

#ifndef NVS_FAKE_H
#define NVS_FAKE_H

#include <stdbool.h>
#include <zephyr/fff.h>
#include <zephyr/kvss/nvs.h>

/* Same signatures as the real API: nvs_read() and nvs_write() return ssize_t */
DECLARE_FAKE_VALUE_FUNC(int, nvs_mount, struct nvs_fs *);
DECLARE_FAKE_VALUE_FUNC(ssize_t, nvs_read, struct nvs_fs *, uint16_t, void *, size_t);
DECLARE_FAKE_VALUE_FUNC(ssize_t, nvs_write, struct nvs_fs *, uint16_t, const void *, size_t);

/**
 * @brief Install the custom_fake callbacks that emulate a one-entry NVS.
 *
 * Call this after nvs_fake_reset() in a before() hook: RESET_FAKE() clears
 * custom_fake, so the callbacks have to be re-installed every time.
 */
void nvs_fake_init(void);

/** @brief Reset all three fakes, the call history and the simulated store. */
void nvs_fake_reset(void);

#endif /* NVS_FAKE_H */
```

## src/nvs_fake.c
```c
/*
 * NVS Fake - definitions and simulated storage
 */

#include "nvs_fake.h"

#include <errno.h>
#include <stdbool.h>
#include <zephyr/fff.h>
#include <zephyr/toolchain.h>

/* Exactly one of these per test binary. */
DEFINE_FFF_GLOBALS;

/* Creates the nvs_*_fake structs */
DEFINE_FAKE_VALUE_FUNC(int, nvs_mount, struct nvs_fs *);
DEFINE_FAKE_VALUE_FUNC(ssize_t, nvs_read, struct nvs_fs *, uint16_t, void *, size_t);
DEFINE_FAKE_VALUE_FUNC(ssize_t, nvs_write, struct nvs_fs *, uint16_t, const void *, size_t);

/* ---- Simulated NVS state ------------------------------------------------ */

/* One int is enough: calculator_nvs only stores CALCULATOR_NVS_ID */
static int simulated_nvs_storage;
static bool has_data;

/* ---- custom_fake implementations ---------------------------------------- */

/* Copies the value while the caller's pointer is still valid */
static ssize_t custom_nvs_write(struct nvs_fs *fs, uint16_t id, const void *data, size_t len)
{
	ARG_UNUSED(fs);
	ARG_UNUSED(id);

	if (len != sizeof(int)) {
		return -EINVAL;
	}

	simulated_nvs_storage = *(const int *)data;
	has_data = true;

	return (ssize_t)len;
}

/* Returns -ENOENT until something is written, like the real NVS */
static ssize_t custom_nvs_read(struct nvs_fs *fs, uint16_t id, void *data, size_t len)
{
	ARG_UNUSED(fs);
	ARG_UNUSED(id);

	if (!has_data) {
		return -ENOENT;
	}

	if (len != sizeof(int)) {
		return -EINVAL;
	}

	*(int *)data = simulated_nvs_storage;

	return (ssize_t)len;
}

/* ---- Public helpers ------------------------------------------------------ */

void nvs_fake_init(void)
{
	nvs_read_fake.custom_fake = custom_nvs_read;
	nvs_write_fake.custom_fake = custom_nvs_write;
}

void nvs_fake_reset(void)
{
	RESET_FAKE(nvs_mount);
	RESET_FAKE(nvs_read);
	RESET_FAKE(nvs_write);

	/* Clears fff.call_history, shared by all fakes */
	FFF_RESET_HISTORY();

	simulated_nvs_storage = 0;
	has_data = false;
}
```

## src/test_basic.c
```c
/*
 * Calculator NVS Unit Tests - Happy Paths
 *
 * Run with:
 *   west twister -T tests/calculator_nvs -p native_sim
 */

#include <errno.h>
#include <zephyr/fff.h>
#include <zephyr/ztest.h>

#include "calculator_nvs.h"
#include "nvs_fake.h"

/* Never dereferenced: the fakes ignore it */
static struct nvs_fs fake_fs;

/* Clean fakes, module not initialised */
static void nvs_uninit_before(void *fixture)
{
	ARG_UNUSED(fixture);

	nvs_fake_reset();
	nvs_fake_init();
	calculator_nvs_deinit();
}

/* Clean fakes, module initialised */
static void nvs_ready_before(void *fixture)
{
	ARG_UNUSED(fixture);

	nvs_fake_reset();
	nvs_fake_init();

	/* zassume_ok: skip the test instead of failing it if init breaks */
	zassume_ok(calculator_nvs_init(&fake_fs), "precondition: init must succeed");
}

/*
 * ============================================================================
 * Test Suite: nvs_init
 *
 * Tests for the calculator_nvs_init() function.
 * ============================================================================
 */
ZTEST_SUITE(nvs_init, NULL, NULL, nvs_uninit_before, NULL, NULL);

ZTEST(nvs_init, test_success)
{
	int ret = calculator_nvs_init(&fake_fs);

	zassert_ok(ret, "init should succeed, got %d", ret);

	/* call_count: how many times the fake was called */
	zassert_equal(nvs_mount_fake.call_count, 1,
		      "nvs_mount should be called exactly once, got %u",
		      nvs_mount_fake.call_count);
	zassert_equal_ptr(nvs_mount_fake.arg0_val, &fake_fs,
			  "the fs pointer must be forwarded unchanged");
}

ZTEST(nvs_init, test_null_fs_pointer)
{
	int ret = calculator_nvs_init(NULL);

	zassert_equal(ret, -EINVAL, "NULL pointer must return -EINVAL, got %d", ret);

	/* The guard must return before the driver is called */
	zassert_equal(nvs_mount_fake.call_count, 0,
		      "nvs_mount must not be called when fs is NULL, got %u calls",
		      nvs_mount_fake.call_count);
}

ZTEST(nvs_init, test_mount_failure)
{
	/* return_val: every call returns this value */
	nvs_mount_fake.return_val = -EIO;

	int ret = calculator_nvs_init(&fake_fs);

	zassert_equal(ret, -EIO, "mount error must be returned unchanged, got %d", ret);
}

/*
 * ============================================================================
 * Test Suite: nvs_add
 *
 * Tests for the calculator_nvs_add() function.
 * ============================================================================
 */
ZTEST_SUITE(nvs_add, NULL, NULL, nvs_ready_before, NULL, NULL);

ZTEST(nvs_add, test_add_positive)
{
	int result = 0;

	zassert_ok(calculator_nvs_add(2, 3, &result), "add(2, 3) should succeed");
	zassert_equal(result, 5, "2 + 3 should equal 5, got %d", result);
	zassert_equal(nvs_write_fake.call_count, 1,
		      "one add must produce one nvs_write, got %u",
		      nvs_write_fake.call_count);
}

ZTEST(nvs_add, test_add_negative)
{
	int result = 0;

	zassert_ok(calculator_nvs_add(-2, -3, &result), "add(-2, -3) should succeed");
	zassert_equal(result, -5, "-2 + -3 should equal -5, got %d", result);
}

ZTEST(nvs_add, test_add_zero)
{
	int result = 999;

	zassert_ok(calculator_nvs_add(0, 0, &result), "add(0, 0) should succeed");
	zassert_equal(result, 0, "0 + 0 should equal 0, got %d", result);
}

ZTEST(nvs_add, test_add_null_result)
{
	int ret = calculator_nvs_add(1, 2, NULL);

	zassert_equal(ret, -EINVAL, "NULL result must return -EINVAL, got %d", ret);
	zassert_equal(nvs_write_fake.call_count, 0,
		      "nothing may be written for invalid arguments, got %u calls",
		      nvs_write_fake.call_count);
}

/*
 * ============================================================================
 * Test Suite: nvs_sub
 *
 * Tests for the calculator_nvs_sub() function.
 * ============================================================================
 */
ZTEST_SUITE(nvs_sub, NULL, NULL, nvs_ready_before, NULL, NULL);

ZTEST(nvs_sub, test_sub_positive_result)
{
	int result = 0;

	zassert_ok(calculator_nvs_sub(10, 4, &result), "sub(10, 4) should succeed");
	zassert_equal(result, 6, "10 - 4 should equal 6, got %d", result);
}

ZTEST(nvs_sub, test_sub_negative_result)
{
	int result = 0;

	zassert_ok(calculator_nvs_sub(4, 10, &result), "sub(4, 10) should succeed");
	zassert_equal(result, -6, "4 - 10 should equal -6, got %d", result);
	zassert_ok(calculator_nvs_get_last_result(&result), "read-back should succeed");
	zassert_equal(result, -6, "a negative result must be persisted too, got %d", result);
}

ZTEST(nvs_sub, test_sub_null_result)
{
	int ret = calculator_nvs_sub(1, 2, NULL);

	zassert_equal(ret, -EINVAL, "NULL result must return -EINVAL, got %d", ret);
	zassert_equal(nvs_write_fake.call_count, 0,
		      "nothing may be written for invalid arguments, got %u calls",
		      nvs_write_fake.call_count);
}

/*
 * ============================================================================
 * Test Suite: nvs_get
 *
 * Tests for the calculator_nvs_get_last_result() function.
 * ============================================================================
 */
ZTEST_SUITE(nvs_get, NULL, NULL, nvs_ready_before, NULL, NULL);

ZTEST(nvs_get, test_get_after_save)
{
	int result = 0;
	int cached = 0;

	zassert_ok(calculator_nvs_add(40, 2, &result), "add must succeed");

	zassert_ok(calculator_nvs_get_last_result(&cached), "read-back should succeed");
	zassert_equal(cached, 42, "round-trip value must survive, got %d", cached);
}

ZTEST(nvs_get, test_get_returns_last_saved)
{
	int result = 0;
	int cached = 0;

	zassert_ok(calculator_nvs_add(1, 1, &result), "first add must succeed");
	zassert_ok(calculator_nvs_sub(100, 1, &result), "sub must succeed");

	zassert_ok(calculator_nvs_get_last_result(&cached), "read-back should succeed");
	zassert_equal(cached, 99, "the most recent write must win, got %d", cached);
}

ZTEST(nvs_get, test_get_no_data)
{
	int cached = 0;
	int ret = calculator_nvs_get_last_result(&cached);

	zassert_equal(ret, -ENOENT, "an empty store must report -ENOENT, got %d", ret);
}

ZTEST(nvs_get, test_get_null_pointer)
{
	int ret = calculator_nvs_get_last_result(NULL);

	zassert_equal(ret, -EINVAL, "NULL result must return -EINVAL, got %d", ret);
	zassert_equal(nvs_read_fake.call_count, 0,
		      "nvs_read must not be called with a NULL destination, got %u calls",
		      nvs_read_fake.call_count);
}
```

## src/test_error_paths.c
```c
/*
 * Calculator NVS Unit Tests - Error Paths and Advanced FFF
 *
 * Run with:
 *   west twister -T tests/calculator_nvs -p native_sim
 */

#include <errno.h>
#include <zephyr/fff.h>
#include <zephyr/ztest.h>

#include "calculator_nvs.h"
#include "nvs_fake.h"

/* Never dereferenced: the fakes ignore it */
static struct nvs_fs fake_fs;

/* Clean fakes, module not initialised */
static void nvs_uninit_before(void *fixture)
{
	ARG_UNUSED(fixture);

	nvs_fake_reset();
	nvs_fake_init();
	calculator_nvs_deinit();
}

/* Clean fakes, module initialised */
static void nvs_ready_before(void *fixture)
{
	ARG_UNUSED(fixture);

	nvs_fake_reset();
	nvs_fake_init();

	zassume_ok(calculator_nvs_init(&fake_fs), "precondition: init must succeed");
}

/*
 * ============================================================================
 * Test Suite: nvs_uninitialized
 *
 * Calls made before calculator_nvs_init().
 * ============================================================================
 */
ZTEST_SUITE(nvs_uninitialized, NULL, NULL, nvs_uninit_before, NULL, NULL);

ZTEST(nvs_uninitialized, test_add_without_init)
{
	int result = 0;
	int ret = calculator_nvs_add(20, 22, &result);

	zassert_equal(ret, -EACCES, "add before init must return -EACCES, got %d", ret);
	zassert_equal(nvs_write_fake.call_count, 0,
		      "nvs_write must not be called before init, got %u calls",
		      nvs_write_fake.call_count);
}

ZTEST(nvs_uninitialized, test_get_without_init)
{
	int result = 0;
	int ret = calculator_nvs_get_last_result(&result);

	zassert_equal(ret, -EACCES, "get before init must return -EACCES, got %d", ret);
	zassert_equal(nvs_read_fake.call_count, 0,
		      "nvs_read must not be called before init, got %u calls",
		      nvs_read_fake.call_count);
}

/*
 * ============================================================================
 * Test Suite: nvs_error_read_write
 *
 * Truncated transfers, injected through the fakes.
 * ============================================================================
 */
ZTEST_SUITE(nvs_error_read_write, NULL, NULL, nvs_ready_before, NULL, NULL);

/* custom_fakes that report a 1-byte transfer instead of sizeof(int) */
static ssize_t truncating_write(struct nvs_fs *fs, uint16_t id, const void *data, size_t len)
{
	ARG_UNUSED(fs);
	ARG_UNUSED(id);
	ARG_UNUSED(data);
	ARG_UNUSED(len);

	return 1;
}

static ssize_t truncating_read(struct nvs_fs *fs, uint16_t id, void *data, size_t len)
{
	ARG_UNUSED(fs);
	ARG_UNUSED(id);
	ARG_UNUSED(data);
	ARG_UNUSED(len);

	return 1;
}

ZTEST(nvs_error_read_write, test_short_write_reports_eio)
{
	int result = 0;

	/* Replaces the custom_fake installed by nvs_fake_init() */
	nvs_write_fake.custom_fake = truncating_write;

	int ret = calculator_nvs_add(2, 2, &result);

	zassert_equal(ret, -EIO, "a truncated write must be reported as -EIO, got %d", ret);
}

ZTEST(nvs_error_read_write, test_short_read_reports_eio)
{
	int result = 0;

	nvs_read_fake.custom_fake = truncating_read;

	int ret = calculator_nvs_get_last_result(&result);

	zassert_equal(ret, -EIO, "a truncated read must be reported as -EIO, got %d", ret);
}

/*
 * ============================================================================
 * Test Suite: nvs_fff_advanced
 *
 * Argument capture, call history and return sequences.
 * ============================================================================
 */
ZTEST_SUITE(nvs_fff_advanced, NULL, NULL, nvs_ready_before, NULL, NULL);

/* arg<N>_val is zero-indexed: nvs_write(fs = arg0, id = arg1, data = arg2, len = arg3) */
ZTEST(nvs_fff_advanced, test_verify_nvs_id_used)
{
	int result = 0;

	zassert_ok(calculator_nvs_add(21, 21, &result), "add must succeed");

	zassert_equal(nvs_write_fake.arg1_val, CALCULATOR_NVS_ID,
		      "the module must write to entry id %u, got %u", CALCULATOR_NVS_ID,
		      nvs_write_fake.arg1_val);
	zassert_equal(nvs_write_fake.arg3_val, sizeof(int),
		      "the module must offer sizeof(int) bytes, got %u",
		      (unsigned int)nvs_write_fake.arg3_val);
}

/* fff.call_history is shared by every fake, so it shows the order across fakes */
ZTEST(nvs_fff_advanced, test_call_history_records_order)
{
	int result = 0;

	/* Entry 0 is the nvs_mount() call made by the before hook */
	zassert_equal(fff.call_history[0], (fff_function_t)nvs_mount,
		      "the first recorded call should be nvs_mount");

	zassert_ok(calculator_nvs_add(90, 9, &result), "add must succeed");
	zassert_ok(calculator_nvs_get_last_result(&result), "get must succeed");

	zassert_equal(fff.call_history[1], (fff_function_t)nvs_write,
		      "add() must write before anything reads");
	zassert_equal(fff.call_history[2], (fff_function_t)nvs_read,
		      "get_last_result() must be the third recorded call");
	zassert_is_null(fff.call_history[3], "no fourth call was expected");
	zassert_equal(result, 99, "the round-trip value must be preserved, got %d", result);
}

/* arg<N>_history keeps the argument of every call, not only the last one */
ZTEST(nvs_fff_advanced, test_arg_history_records_every_call)
{
	int result = 0;

	zassert_ok(calculator_nvs_add(1, 1, &result), "add must succeed");
	zassert_ok(calculator_nvs_sub(9, 4, &result), "sub must succeed");

	zassert_equal(nvs_write_fake.call_count, 2,
		      "two operations must produce two writes, got %u",
		      nvs_write_fake.call_count);
	zassert_equal(nvs_write_fake.arg1_history[0], CALCULATOR_NVS_ID,
		      "the first write must use entry id %u", CALCULATOR_NVS_ID);
	zassert_equal(nvs_write_fake.arg1_history[1], CALCULATOR_NVS_ID,
		      "every write must use the same entry id");
	zassert_equal(nvs_write_fake.arg_histories_dropped, 0,
		      "no argument history should have been dropped, got %u",
		      nvs_write_fake.arg_histories_dropped);
}

/* SET_RETURN_SEQ: one return value per call. An exhausted sequence repeats its
 * last element instead of falling back to return_val.
 */
ZTEST(nvs_fff_advanced, test_return_val_sequence)
{
	static ssize_t seq[] = {-EIO, -ENOSPC};
	int result = 0;

	/* Clear custom_fake, or the sequence is ignored */
	nvs_write_fake.custom_fake = NULL;
	SET_RETURN_SEQ(nvs_write, seq, ARRAY_SIZE(seq));

	zassert_equal(calculator_nvs_add(1, 0, &result), -EIO, "call 1: seq[0] is -EIO");
	zassert_equal(calculator_nvs_add(2, 0, &result), -ENOSPC, "call 2: seq[1] is -ENOSPC");
	zassert_equal(calculator_nvs_add(3, 0, &result), -ENOSPC,
		      "call 3: an exhausted sequence repeats its last element");

	zassert_equal(nvs_write_fake.call_count, 3, "three adds must produce three writes, got %u",
		      nvs_write_fake.call_count);
}

/* SET_CUSTOM_FAKE_SEQ: one function per call. It outranks custom_fake, so the
 * callback from nvs_fake_init() is not used.
 */
static int seq_stored;

static ssize_t seq_write_ok(struct nvs_fs *fs, uint16_t id, const void *data, size_t len)
{
	ARG_UNUSED(fs);
	ARG_UNUSED(id);

	seq_stored = *(const int *)data;

	return (ssize_t)len;
}

static ssize_t seq_write_short(struct nvs_fs *fs, uint16_t id, const void *data, size_t len)
{
	ARG_UNUSED(fs);
	ARG_UNUSED(id);
	ARG_UNUSED(data);
	ARG_UNUSED(len);

	return 1;
}

ZTEST(nvs_fff_advanced, test_custom_fake_seq_runs_each_function)
{
	static ssize_t (*write_seq[])(struct nvs_fs *, uint16_t, const void *, size_t) = {
		seq_write_ok,
		seq_write_short,
	};
	int result = 0;

	seq_stored = 0;
	SET_CUSTOM_FAKE_SEQ(nvs_write, write_seq, ARRAY_SIZE(write_seq));

	zassert_ok(calculator_nvs_add(2, 3, &result), "call 1: seq_write_ok stores 5");
	zassert_equal(calculator_nvs_add(1, 1, &result), -EIO,
		      "call 2: a short write must be reported as -EIO");
	zassert_equal(calculator_nvs_add(4, 4, &result), -EIO,
		      "call 3: an exhausted sequence repeats its last function");
	zassert_equal(seq_stored, 5, "call 1 must have written 5, got %d", seq_stored);
}
```
