## CMakeLists.txt
```
cmake_minimum_required(VERSION 3.20.0)
find_package(Zephyr REQUIRED HINTS $ENV{ZEPHYR_BASE})

project(temp_alarm_unit_test)

target_sources(app PRIVATE
    src/sensor_fake.c
    src/test_basic.c
    src/test_error_paths.c
    ${CMAKE_CURRENT_SOURCE_DIR}/../../app/modules/temp_alarm/src/temp_alarm.c
)

target_include_directories(app PRIVATE
    ${CMAKE_CURRENT_SOURCE_DIR}/../../app/modules/temp_alarm/include
    include
)
```

## prj.conf
```kconfig
# Enable the Ztest unit testing framework
CONFIG_ZTEST=y

# Increase stack size for test threads to avoid hitting limits during test execution
CONFIG_ZTEST_STACK_SIZE=4096

# Randomize suite and test order to catch ordering dependencies early
CONFIG_ZTEST_SHUFFLE=y

# Enable logging for debugging test failures
CONFIG_LOG=y

# Sensor subsystem: required to compile sensor.h types and z_impl_* helpers
CONFIG_SENSOR=y
```

## include/sensor_fake.h
```c
/*
 * Sensor Fake - FFF fakes behind a fake struct device
 */

#ifndef SENSOR_FAKE_H
#define SENSOR_FAKE_H

#include <zephyr/device.h>
#include <zephyr/drivers/sensor.h>
#include <zephyr/fff.h>

/* TODO(l8-task0): declare fake_sensor_sample_fetch, the FFF fake for
 * sensor_driver_api.sample_fetch. See HOMEWORK.md, Task 0.
 */
DECLARE_FAKE_VALUE_FUNC(int, fake_sensor_sample_fetch, const struct device *, enum sensor_channel);

/* FFF fake for sensor_driver_api.channel_get. */
DECLARE_FAKE_VALUE_FUNC(int, fake_sensor_channel_get, const struct device *, enum sensor_channel,
			struct sensor_value *);

/** The fake sensor device the tests pass to temp_alarm_init(). */
extern struct device fake_sensor_dev;

/** @brief Set the temperature, in whole degrees Celsius, that channel_get returns. */
void sensor_fake_set_temperature(int temp_celsius);

/**
 * @brief Install the custom_fake on fake_sensor_channel_get.
 *
 * Call it after sensor_fake_reset(), because RESET_FAKE() clears custom_fake.
 */
void sensor_fake_init(void);

/** @brief Reset every FFF fake, the call history and the simulated temperature. */
void sensor_fake_reset(void);

#endif /* SENSOR_FAKE_H */
```

## src/sensor_fake.c
```c
/*
 * Sensor Fake - definitions, simulated temperature and the fake device
 */

#include "sensor_fake.h"

#include <zephyr/fff.h>
#include <zephyr/toolchain.h>

/* Exactly one of these per test binary. */
DEFINE_FFF_GLOBALS;

/* TODO(l8-task0): define fake_sensor_sample_fetch, matching your declaration in sensor_fake.h. */
DEFINE_FAKE_VALUE_FUNC(int, fake_sensor_sample_fetch, const struct device *, enum sensor_channel);

DEFINE_FAKE_VALUE_FUNC(int, fake_sensor_channel_get, const struct device *, enum sensor_channel,
		       struct sensor_value *);

/* ---- Simulated sensor state ---------------------------------------------- */

static int sim_temperature;

/*
 * Writes the simulated temperature into the caller's sensor_value. val1 holds
 * the whole degrees; val2 (millionths) is not used, so it is set to 0.
 */
static int custom_sensor_channel_get(const struct device *dev, enum sensor_channel chan,
				     struct sensor_value *val)
{
	ARG_UNUSED(dev);
	ARG_UNUSED(chan);

	val->val1 = sim_temperature;
	val->val2 = 0;

	return 0;
}

/* ---- Fake sensor device -------------------------------------------------- */

/* The API table temp_alarm.c calls through. */
// static const struct sensor_driver_api fake_sensor_api = {
static DEVICE_API(sensor, fake_sensor_api) = {
	/* TODO(l8-task0): replace NULL with fake_sensor_sample_fetch. */
	.sample_fetch = fake_sensor_sample_fetch,
	.channel_get = fake_sensor_channel_get,
};

/* initialized = 1 and init_res = 0 make device_is_ready() return true. */
static struct device_state fake_sensor_state = {
	.init_res = 0,
	.initialized = 1,
};

struct device fake_sensor_dev = {
	.name = "fake_sensor",
	.api = &fake_sensor_api,
	.state = &fake_sensor_state,
};

/* ---- Public helpers ------------------------------------------------------ */

void sensor_fake_set_temperature(int temp_celsius)
{
	sim_temperature = temp_celsius;
}

void sensor_fake_init(void)
{
	fake_sensor_channel_get_fake.custom_fake = custom_sensor_channel_get;
}

void sensor_fake_reset(void)
{
	/* TODO(l8-task0): reset fake_sensor_sample_fetch here too. */
	RESET_FAKE(fake_sensor_sample_fetch);
	RESET_FAKE(fake_sensor_channel_get);
	FFF_RESET_HISTORY();

	sim_temperature = 0;
}
```

## src/test_basic.c
```c
/*
 * temp_alarm - Happy-path unit tests (homework skeleton)
 *
 * test_status_after_init is provided as a worked example. Finish Task 0 first,
 * then fill in the Task 1 stubs according to TEST_SPEC.md. The stubs call
 * ztest_test_skip(), so the binary builds and runs cleanly until each test is
 * implemented.
 *
 * Run:
 *   west twister -T tests/temp_alarm -p native_sim
 */

#include <errno.h>
#include <zephyr/fff.h>
#include <zephyr/ztest.h>

#include "sensor_fake.h"
#include "temp_alarm.h"

#define DEFAULT_THRESHOLD 30

/*
 * Shared by every suite: a clean fake, then the module initialised
 * with the fake device. temp_alarm_init() resets all module state,
 * so no deinit is needed between tests.
 */
static void before(void *fixture)
{
	ARG_UNUSED(fixture);

	sensor_fake_reset();
	sensor_fake_init();

	zassume_ok(temp_alarm_init(&fake_sensor_dev, DEFAULT_THRESHOLD),
		   "precondition: temp_alarm_init must succeed");
}

/*
 * ============================================================================
 * Test Suite: temp_alarm_get_status
 *
 * The status right after a successful init.
 * ============================================================================
 */
ZTEST_SUITE(temp_alarm_get_status, NULL, NULL, before, NULL, NULL);

/* PROVIDED — study this test before writing the rest. */
ZTEST(temp_alarm_get_status, test_status_after_init)
{
	struct temp_alarm_status status;

	zassert_ok(temp_alarm_get_status(&status), "get_status must succeed");

	zassert_equal(status.last_temp, 0, "last_temp must be 0 after init, got %d",
		      status.last_temp);
	zassert_equal(status.alarm_count, 0U, "alarm_count must be 0 after init, got %u",
		      status.alarm_count);
	zassert_false(status.is_alarming, "is_alarming must be false after init");
	zassert_equal(status.last_error, 0, "last_error must be 0 after init, got %d",
		      status.last_error);
}

/*
 * ============================================================================
 * Test Suite: temp_alarm_check
 *
 * Readings below, at and above the threshold.
 * ============================================================================
 */
ZTEST_SUITE(temp_alarm_check, NULL, NULL, before, NULL, NULL);

ZTEST(temp_alarm_check, test_below_threshold)
{
	/* TODO(l8-task1): a reading of 20 C is below the threshold.
	 * Check the status, and how the module talked to the sensor.
	 * See TEST_SPEC.md "Suite temp_alarm_check" #1.
	 * 
	 * **Verify #1:** `status.last_temp == 20` and `status.is_alarming == false`. The
	 * module fetched a sample exactly once, and read the ambient temperature
	 * channel (`SENSOR_CHAN_AMBIENT_TEMP`).
	 */
	struct temp_alarm_status status;
	sensor_fake_set_temperature(20);
	zassert_equal(temp_alarm_check(), 0, "check must succeed");
	zassert_ok(temp_alarm_get_status(&status), "get_status must succeed");
	zassert_equal(status.last_temp, 20, "last_temp must be 20, got %d", status.last_temp);
	zassert_false(status.is_alarming, "is_alarming must be false");
}

ZTEST(temp_alarm_check, test_at_threshold)
{
	/* TODO(l8-task1): a reading equal to the threshold (30 C) is not an alarm.
	 * See TEST_SPEC.md "Suite temp_alarm_check" #2.
	 **Verify #2:** `status.is_alarming == false` and `status.alarm_count == 0`. The
	 * alarm needs a reading strictly above the threshold.
	 */
	struct temp_alarm_status status;
	sensor_fake_set_temperature(30);
	zassert_equal(temp_alarm_check(), 0, "check must succeed");
	zassert_ok(temp_alarm_get_status(&status), "get_status must succeed");
	zassert_false(status.is_alarming, "is_alarming must be false");
	zassert_equal(status.alarm_count, 0U, "alarm_count must be 0");
	zassert_equal(fake_sensor_sample_fetch_fake.call_count, 1U);
	zassert_equal(fake_sensor_channel_get_fake.call_count, 1U);
}

ZTEST(temp_alarm_check, test_above_threshold)
{
	/* TODO(l8-task1): a reading of 40 C raises the alarm and counts it.
	 * See TEST_SPEC.md "Suite temp_alarm_check" #3.
	 * **Verify #3:** `status.last_temp == 40`, `status.is_alarming == true` and
	 * `status.alarm_count == 1`.
	 */
	struct temp_alarm_status status;
	sensor_fake_set_temperature(40);
	zassert_equal(temp_alarm_check(), 0, "check must succeed");
	zassert_ok(temp_alarm_get_status(&status), "get_status must succeed");
	zassert_equal(status.last_temp, 40, "last_temp must be 40, got %d", status.last_temp);
	zassert_true(status.is_alarming, "is_alarming must be true");
	zassert_equal(status.alarm_count, 1U, "alarm_count must be 1");
}

/*
 * ============================================================================
 * Test Suite: temp_alarm_threshold
 *
 * Changing the threshold at run time.
 * ============================================================================
 */
ZTEST_SUITE(temp_alarm_threshold, NULL, NULL, before, NULL, NULL);

ZTEST(temp_alarm_threshold, test_new_threshold_clears_alarm)
{
	/* TODO(l8-task1): raise the alarm, then move the threshold
	 * above the reading. The alarm must clear and stay cleared.
	 * See TEST_SPEC.md "Suite temp_alarm_threshold" #1.
	 * **Verify #1:** the first `check()` raises the alarm. Right after
	 * `set_threshold(50)`, `status.is_alarming == false`. After the second
	 * `check()`, `status.is_alarming == false` (40 C is below 50 C) and
	 * `status.alarm_count == 1` (still only the first alarm).
	 */
	struct temp_alarm_status status;
	sensor_fake_set_temperature(40);
	zassert_equal(temp_alarm_check(), 0, "check must succeed");
	zassert_ok(temp_alarm_get_status(&status), "get_status must succeed");
	zassert_true(status.is_alarming, "is_alarming must be true before threshold change");
	zassert_equal(status.alarm_count, 1U, "alarm_count must be 1");

	zassert_equal(temp_alarm_set_threshold(50), 0, "set_threshold must succeed");
	zassert_equal(temp_alarm_check(), 0, "check must succeed");
	zassert_ok(temp_alarm_get_status(&status), "get_status must succeed");
	zassert_equal(status.last_temp, 40, "last_temp must be 40, got %d", status.last_temp);
	zassert_false(status.is_alarming, "is_alarming must be false after threshold change");
	zassert_equal(status.alarm_count, 1U, "alarm_count must be 1");

}

/*
 * ============================================================================
 * Test Suite: temp_alarm_reset
 *
 * temp_alarm_reset() clears the alarm but keeps the last reading.
 * ============================================================================
 */
ZTEST_SUITE(temp_alarm_reset, NULL, NULL, before, NULL, NULL);

ZTEST(temp_alarm_reset, test_reset_clears_state)
{
	/* TODO(l8-task1): raise the alarm three times, then reset.
	 * The alarm state must clear, but the last reading must stay.
	 * See TEST_SPEC.md "Suite temp_alarm_reset" #1.
	 * **Verify #1:** the three checks leave `status.alarm_count == 3`.
	 * After the reset, `status.is_alarming == false`, `status.alarm_count == 0`,
	 * `status.last_error == 0`, and `status.last_temp == 40` (reset keeps the last
	 * reading).
	 */
	struct temp_alarm_status status;
	sensor_fake_set_temperature(40);
	zassert_equal(temp_alarm_check(), 0, "check must succeed");
	zassert_equal(temp_alarm_check(), 0, "check must succeed");
	zassert_equal(temp_alarm_check(), 0, "check must succeed");

	zassert_ok(temp_alarm_get_status(&status), "get_status must succeed");
	zassert_equal(status .alarm_count, 3U, "alarm_count must be 3");
	zassert_equal(status.last_temp, 40, "last_temp must be 40, got %d", status.last_temp);
	zassert_true(status.is_alarming, "is_alarming must be true before reset");
	zassert_equal(fake_sensor_sample_fetch_fake.call_count, 3U);
	zassert_equal(fake_sensor_channel_get_fake.call_count, 3U);
	
	temp_alarm_reset();

	zassert_ok(temp_alarm_get_status(&status));

	zassert_false(status.is_alarming, "is_alarming must be false after reset");
	zassert_equal(status.alarm_count, 0U, "alarm count must be 0");
	zassert_equal(status.last_error, 0, "last error must be 0");
	zassert_equal(status.last_temp, 40, "last temperature must be 40");

	/* Reset must not perform additional sensor reads. */
	zassert_equal(fake_sensor_sample_fetch_fake.call_count, 3U);
	zassert_equal(fake_sensor_channel_get_fake.call_count, 3U);
}
```

## src/test_error_paths.c
```c
/*
 * temp_alarm - Error-path unit tests (homework skeleton)
 *
 * Task 2: fill in the stubs according to TEST_SPEC.md. Each stub calls
 * ztest_test_skip(), so the binary builds and runs cleanly until the test is
 * implemented.
 *
 * Run:
 *   west twister -T tests/temp_alarm -p native_sim
 */

#include <errno.h>
#include <zephyr/fff.h>
#include <zephyr/ztest.h>

#include "sensor_fake.h"
#include "temp_alarm.h"

#define DEFAULT_THRESHOLD 30

/* Same before() hook as in test_basic.c: a clean fake and an initialised module. */
static void before(void *fixture)
{
	ARG_UNUSED(fixture);

	sensor_fake_reset();
	sensor_fake_init();

	zassume_ok(temp_alarm_init(&fake_sensor_dev, DEFAULT_THRESHOLD),
		   "precondition: temp_alarm_init must succeed");
}

/*
 * ============================================================================
 * Test Suite: temp_alarm_sensor_errors
 *
 * Failures from the sensor driver, injected through the fakes.
 * ============================================================================
 */
ZTEST_SUITE(temp_alarm_sensor_errors, NULL, NULL, before, NULL, NULL);

ZTEST(temp_alarm_sensor_errors, test_fetch_error_propagates)
{
	/* TODO(l8-task2): a failed fetch is reported,
	 * and the module does not go on to read the channel.
	 * See TEST_SPEC.md "Suite temp_alarm_sensor_errors" #1.
	 */
    struct temp_alarm_status status;

    fake_sensor_channel_get_fake.custom_fake = NULL;
    fake_sensor_channel_get_fake.return_val = -EIO;

    zassert_equal(temp_alarm_check(), -EIO, "channel get error not propagated");

    zassert_ok(temp_alarm_get_status(&status), "get_status must succeed");
    zassert_equal(status.last_error, -EIO, "last_error not set to channel get error");
    zassert_equal(fake_sensor_sample_fetch_fake.call_count, 1U);
    zassert_equal(fake_sensor_channel_get_fake.call_count, 1U);

}

ZTEST(temp_alarm_sensor_errors, test_channel_get_error_propagates)
{
	/* TODO(l8-task2): a failed channel read is reported.
	 * See TEST_SPEC.md "Suite temp_alarm_sensor_errors" #2.
	 */
	struct temp_alarm_status status;

	fake_sensor_channel_get_fake.custom_fake = NULL;
    fake_sensor_channel_get_fake.return_val = -EIO;
	
	zassert_equal(temp_alarm_check(), -EIO, "channel get error not propagated");
	zassert_ok(temp_alarm_get_status(&status), "get_status must succeed");
	zassert_equal(status.last_error, -EIO, "last_error not set to channel get error");
	zassert_equal(fake_sensor_sample_fetch_fake.call_count, 1U, "sample_fetch must be called once, got %u", fake_sensor_sample_fetch_fake.call_count);

}

ZTEST(temp_alarm_sensor_errors, test_fail_then_recover)
{
	/* TODO(l8-task2): the first fetch fails and the second one succeeds.
	 * The module must recover on the second check.
	 * See TEST_SPEC.md "Suite temp_alarm_sensor_errors" #3.
	 */
	struct temp_alarm_status status;

	sensor_fake_set_temperature(20);


	fake_sensor_sample_fetch_fake.return_val = -EIO;

	zassert_equal(temp_alarm_check(), -EIO);

	zassert_ok(temp_alarm_get_status(&status));
	zassert_equal(status.last_error, -EIO);


	fake_sensor_sample_fetch_fake.return_val = 0;

	zassert_ok(temp_alarm_check());
	zassert_ok(temp_alarm_get_status(&status));

	zassert_equal(status.last_temp, 20, "20 is set");
	zassert_false(status.is_alarming, "is_alarming must be false");
	zassert_equal(status.alarm_count, 0U);
	zassert_equal(status.last_error, -EIO);

	zassert_equal(fake_sensor_sample_fetch_fake.call_count, 2U);
	zassert_equal(fake_sensor_channel_get_fake.call_count, 1U);
}

/*
 * ============================================================================
 * Test Suite: temp_alarm_invalid_input
 *
 * Arguments the public API must reject.
 * ============================================================================
 */
ZTEST_SUITE(temp_alarm_invalid_input, NULL, NULL, before, NULL, NULL);

ZTEST(temp_alarm_invalid_input, test_get_status_null)
{
	/* TODO(l8-task2): a NULL status pointer is rejected.
	 * See TEST_SPEC.md "Suite temp_alarm_invalid_input" #1.
	 */
		zassert_equal(temp_alarm_get_status(NULL), -EINVAL, "NULL status pointer must be rejected");
}

ZTEST(temp_alarm_invalid_input, test_init_without_device)
{
	/* TODO(l8-task2): init without a sensor device is rejected.
	 * See TEST_SPEC.md "Suite temp_alarm_invalid_input" #2.
	 */
	zassert_equal(temp_alarm_init(NULL, DEFAULT_THRESHOLD), -ENODEV, "NULL sensor device must be rejected");
}

ZTEST(temp_alarm_invalid_input, test_init_threshold_out_of_range)
{
	/* TODO(l8-task2): init rejects thresholds outside the allowed range.
	 * See TEST_SPEC.md "Suite temp_alarm_invalid_input" #3.
	 */
	zassert_equal(temp_alarm_init(&fake_sensor_dev, -1), -EINVAL, "Negative threshold must be rejected");

	zassert_equal(temp_alarm_init(&fake_sensor_dev, 101), -EINVAL, "Threshold above 100 must be rejected");
}

ZTEST(temp_alarm_invalid_input, test_set_threshold_out_of_range)
{
	/* TODO(l8-task2): set_threshold rejects values outside the allowed range,
	 * and keeps the old threshold.
	 * See TEST_SPEC.md "Suite temp_alarm_invalid_input" #4.
	 */
	struct temp_alarm_status status;

	zassert_equal(temp_alarm_set_threshold(-1), -EINVAL);
	zassert_equal(temp_alarm_set_threshold(101), -EINVAL);

	sensor_fake_set_temperature(40);

	zassert_ok(temp_alarm_check());
	zassert_ok(temp_alarm_get_status(&status));

	zassert_equal(status.last_temp, 40);
	zassert_true(status.is_alarming);
	zassert_equal(status.alarm_count, 1U);
}
```
